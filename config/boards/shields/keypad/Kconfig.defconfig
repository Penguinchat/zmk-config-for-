## config/boards/shields/keypad/Kconfig.defconfig
```kconfig
if SHIELD_KEYPAD

config ZMK_KEYBOARD_NAME
    default "KEYPAD"
config ZMK_STATUS_LED
    default y
endif
```

## config/west.yml
```yaml
manifest:
  remotes:
    - name: zmkfirmware
      url-base: https://github.com/zmkfirmware
    - name: caksoylar  # <-- new entry
      url-base: https://github.com/caksoylar
    - name: sekigon-gonnoc
      url-base: https://github.com/sekigon-gonnoc
  projects:
    - name: zmk
      remote: zmkfirmware
      revision: main
      import: app/west.yml
    - name: zmk-rgbled-widget  # <-- new entry
      remote: caksoylar
      revision: main
    - name: zmk-feature-status-led
      remote: sekigon-gonnoc
      revision: main
  self:
    path: config
```
